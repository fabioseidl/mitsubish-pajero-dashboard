#include "glass_screen_controller.h"

#ifndef UNIT_TEST

#include <Arduino.h>
#include <Arduino_GFX_Library.h>

#include "pin_config.h"

#ifndef GLASS_MIRROR_X
#define GLASS_MIRROR_X 0
#endif
#ifndef GLASS_MIRROR_Y
#define GLASS_MIRROR_Y 0
#endif

// Roboto Bold 56 px, digits and '-' only, generated by lv_font_conv from
// ui/client_simple_hud/assets/Roboto-Bold.ttf. Three digits span ~97 px.
extern const lv_font_t ui_font_roboto_bold_56;

// ── Arduino_GFX stack ────────────────────────────────────────────────────────
static Arduino_DataBus* s_bus   = nullptr;
static Arduino_GFX*     s_panel = nullptr;

// LVGL partial-render buffer: 40 rows of RGB565. No PSRAM on the C6, so keep it
// small — it sits in internal SRAM alongside the Wi-Fi stack.
static constexpr uint32_t LVGL_BUF_ROWS = 40;
static uint8_t s_lv_buf[SCREEN_W * LVGL_BUF_ROWS * sizeof(uint16_t)];

// One row of mirrored pixels, reused every flush when GLASS_MIRROR_X is set.
static uint16_t s_mirror_row[SCREEN_W];

// ── Init ─────────────────────────────────────────────────────────────────────

bool GlassScreenController::begin() {
    if (!initDisplay()) return false;
    initLvgl();

    lv_obj_t* scr = lv_screen_active();
    lv_obj_set_style_bg_color(scr, lv_color_black(), LV_PART_MAIN);
    lv_obj_set_style_bg_opa(scr, LV_OPA_COVER, LV_PART_MAIN);
    lv_obj_clear_flag(scr, LV_OBJ_FLAG_SCROLLABLE);

    speed_label_ = lv_label_create(scr);
    lv_obj_set_style_text_font(speed_label_, &ui_font_roboto_bold_56, LV_PART_MAIN);

    repaint();  // establishes the "--" offline placeholder
    return true;
}

bool GlassScreenController::initDisplay() {
    // Park the TF-card CS high so it never contends on the shared SPI bus.
    pinMode(GPIO_SD_CS, OUTPUT);
    digitalWrite(GPIO_SD_CS, HIGH);

    s_bus = new Arduino_ESP32SPI(GPIO_LCD_DC, GPIO_LCD_CS, GPIO_LCD_SCLK,
                                 GPIO_LCD_MOSI, GFX_NOT_DEFINED /*MISO*/);
    // IPS glass → colour inversion on. Offsets are given for rotation 0; the
    // driver re-applies them for the requested rotation.
    s_panel = new Arduino_ST7789(s_bus, GPIO_LCD_RST, SCREEN_ROTATION, true /*IPS*/,
                                 PANEL_NATIVE_W, PANEL_NATIVE_H,
                                 PANEL_COL_OFFSET, PANEL_ROW_OFFSET,
                                 PANEL_COL_OFFSET, PANEL_ROW_OFFSET);

    if (!s_panel->begin()) {
        Serial.println("[SCREEN] ST7789 init failed");
        return false;
    }
    s_panel->fillScreen(0x0000);  // RGB565 black
    Serial.printf("[SCREEN] display %dx%d ready\n", s_panel->width(), s_panel->height());
    return true;
}

void GlassScreenController::initLvgl() {
    lv_init();
    lv_tick_set_cb(tickCb);

    lv_display_t* disp = lv_display_create(SCREEN_W, SCREEN_H);
    lv_display_set_flush_cb(disp, flushCb);
    lv_display_set_buffers(disp, s_lv_buf, nullptr, sizeof(s_lv_buf),
                           LV_DISPLAY_RENDER_MODE_PARTIAL);
}

// ── LVGL callbacks ───────────────────────────────────────────────────────────

uint32_t GlassScreenController::tickCb() {
    return millis();
}

// draw16bitRGBBitmap already emits RGB565 big-endian over SPI, which matches
// LVGL's native pixels on this little-endian MCU — no byte swap here.
void GlassScreenController::flushCb(lv_display_t* disp, const lv_area_t* area, uint8_t* px_map) {
    const int32_t w = lv_area_get_width(area);
    const int32_t h = lv_area_get_height(area);
    uint16_t* src = (uint16_t*)px_map;

    if (!GLASS_MIRROR_X && !GLASS_MIRROR_Y) {
        s_panel->draw16bitRGBBitmap(area->x1, area->y1, src, w, h);
    } else {
        // Reflect the area's position, then the pixels inside it, one row at a
        // time so a partial area lands in the right place on the far side.
        // Y alone = mirrored + upside down; X and Y together = plain 180°.
        const int32_t dst_x = GLASS_MIRROR_X ? (SCREEN_W - 1 - area->x2) : area->x1;
        for (int32_t row = 0; row < h; ++row) {
            uint16_t* s = src + (size_t)row * w;
            uint16_t* out = s;
            if (GLASS_MIRROR_X) {
                for (int32_t i = 0; i < w; ++i) s_mirror_row[i] = s[w - 1 - i];
                out = s_mirror_row;
            }
            const int32_t y = area->y1 + row;
            const int32_t dst_y = GLASS_MIRROR_Y ? (SCREEN_H - 1 - y) : y;
            s_panel->draw16bitRGBBitmap(dst_x, dst_y, out, w, 1);
        }
    }

    lv_display_flush_ready(disp);
}

// ── Data in ──────────────────────────────────────────────────────────────────

void GlassScreenController::onPayloadReceived(const Payload& payload) {
    // Runs in the ESP-NOW callback: just record, let tick() touch the widgets.
    // LVGL is not reentrant and must only be driven from the loop task.
    speed_kmh_ = payload.speed_kmh;
}

void GlassScreenController::onServerStatusChanged(bool online) {
    online_ = online;
}

void GlassScreenController::repaint() {
    if (shown_online_) {
        lv_label_set_text_fmt(speed_label_, "%u", shown_speed_);
        lv_obj_set_style_text_color(speed_label_, lv_color_white(), LV_PART_MAIN);
    } else {
        // No server: grey dashes, so a stale reading is never mistaken for live.
        lv_label_set_text(speed_label_, "--");
        lv_obj_set_style_text_color(speed_label_, lv_color_hex(0x505050), LV_PART_MAIN);
    }
    // The label auto-sizes, so re-centre after every text change.
    lv_obj_align(speed_label_, LV_ALIGN_CENTER, 0, 0);
}

void GlassScreenController::tick() {
    // Snapshot once: the ESP-NOW callback can land between the two reads.
    const uint8_t speed  = speed_kmh_;
    const bool    online = online_;
    if (speed != shown_speed_ || online != shown_online_) {
        shown_speed_  = speed;
        shown_online_ = online;
        repaint();
    }
    lv_timer_handler();
}

#endif // UNIT_TEST
